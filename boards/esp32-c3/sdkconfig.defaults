## boards/esp32-c3/sdkconfig.defaults
```kconfig
# Board: Generic ESP32-C3
# Chip:  ESP32-C3 — single-core RISC-V, native USB, BLE 5, low cost

CONFIG_BOARD_DUAL_CORE=n
CONFIG_BOARD_HAS_BT_CLASSIC=n
CONFIG_BOARD_HAS_BLE=y
CONFIG_BOARD_HAS_WIFI=y
CONFIG_BOARD_HAS_NATIVE_USB=y
CONFIG_BOARD_HAS_ZIGBEE=n

CONFIG_ESPTOOLPY_FLASHSIZE_4MB=y
CONFIG_ESPTOOLPY_FLASHFREQ_80M=y
CONFIG_ESPTOOLPY_FLASHMODE_DIO=y

CONFIG_ESP_CONSOLE_USB_SERIAL_JTAG=y
```

## boards/esp32-c6/sdkconfig.defaults
```kconfig
# Board: Generic ESP32-C6
# Chip:  ESP32-C6 — single-core RISC-V, WiFi 6, Zigbee, Thread, BLE 5

CONFIG_BOARD_DUAL_CORE=n
CONFIG_BOARD_HAS_BT_CLASSIC=n
CONFIG_BOARD_HAS_BLE=y
CONFIG_BOARD_HAS_WIFI=y
CONFIG_BOARD_HAS_NATIVE_USB=y
CONFIG_BOARD_HAS_ZIGBEE=y

CONFIG_ESPTOOLPY_FLASHSIZE_4MB=y
CONFIG_ESPTOOLPY_FLASHFREQ_80M=y
CONFIG_ESPTOOLPY_FLASHMODE_DIO=y

CONFIG_ESP_CONSOLE_USB_SERIAL_JTAG=y
```

## boards/esp32-h2/sdkconfig.defaults
```kconfig
# Board: Generic ESP32-H2
# Chip:  ESP32-H2 — single-core RISC-V, NO WiFi, Zigbee/Thread, BLE 5

CONFIG_BOARD_DUAL_CORE=n
CONFIG_BOARD_HAS_BT_CLASSIC=n
CONFIG_BOARD_HAS_BLE=y
CONFIG_BOARD_HAS_WIFI=n
CONFIG_BOARD_HAS_NATIVE_USB=n
CONFIG_BOARD_HAS_ZIGBEE=y

CONFIG_ESPTOOLPY_FLASHSIZE_4MB=y
CONFIG_ESPTOOLPY_FLASHFREQ_48M=y
CONFIG_ESPTOOLPY_FLASHMODE_DIO=y

# H2 has no WiFi — disable WiFi-dependent components
CONFIG_WEBSERVER_REQUIRES_WIFI=n
```

## boards/esp32-s3/sdkconfig.defaults
```kconfig
# Board: Generic ESP32-S3
# Chip:  ESP32-S3 — dual-core Xtensa LX7, native USB, BLE 5, AI acceleration

CONFIG_BOARD_DUAL_CORE=y
CONFIG_BOARD_HAS_BT_CLASSIC=n
CONFIG_BOARD_HAS_BLE=y
CONFIG_BOARD_HAS_WIFI=y
CONFIG_BOARD_HAS_NATIVE_USB=y
CONFIG_BOARD_HAS_ZIGBEE=n

CONFIG_ESPTOOLPY_FLASHSIZE_4MB=y
CONFIG_ESPTOOLPY_FLASHFREQ_80M=y
CONFIG_ESPTOOLPY_FLASHMODE_DIO=y

# Native USB — use USB-OTG for serial monitor on S3
CONFIG_ESP_CONSOLE_USB_SERIAL_JTAG=y
```

## boards/esp32/sdkconfig.defaults
```kconfig
# Board: Generic ESP32 (ESP32-WROOM-32 / ESP32-WROVER)
# Chip:  ESP32 — dual-core Xtensa LX6, classic BT + BLE 4.2, no native USB

# Chip capability flags
CONFIG_BOARD_DUAL_CORE=y
CONFIG_BOARD_HAS_BT_CLASSIC=y
CONFIG_BOARD_HAS_BLE=y
CONFIG_BOARD_HAS_WIFI=y
CONFIG_BOARD_HAS_NATIVE_USB=n
CONFIG_BOARD_HAS_ZIGBEE=n

# Flash
CONFIG_ESPTOOLPY_FLASHSIZE_4MB=y
CONFIG_ESPTOOLPY_FLASHFREQ_80M=y
CONFIG_ESPTOOLPY_FLASHMODE_DIO=y

# PSRAM (disable for WROOM; enable for WROVER)
CONFIG_ESP32_SPIRAM_SUPPORT=n
```

## boards/examples/feather-huzzah32/sdkconfig.defaults
```kconfig
# Board: Adafruit Feather HUZZAH32
# Chip:  ESP32-WROOM-32 (ESP32 rev 1)
# Flash: 4 MB
# PSRAM: None
# USB:   CP2104 USB-to-serial (no native USB)
# Notes: - LED on GPIO 13 (red, active high)
#          An onboard blue LED also exists on some revisions at GPIO 13.
#        - VBAT sense on A13 / GPIO 35 (ADC1_CH7) — 1/2 divider
#        - No built-in BOOT button labelled as such; GPIO 0 is connected
#          to the low-side of the RST button on some revisions.

# Inherit generic ESP32 chip defaults
CONFIG_BOARD_DUAL_CORE=y
CONFIG_BOARD_HAS_BT_CLASSIC=y
CONFIG_BOARD_HAS_BLE=y
CONFIG_BOARD_HAS_WIFI=y
CONFIG_BOARD_HAS_NATIVE_USB=n
CONFIG_BOARD_HAS_ZIGBEE=n

# Flash config for CP2104 + WROOM-32
CONFIG_ESPTOOLPY_FLASHSIZE_4MB=y
CONFIG_ESPTOOLPY_FLASHFREQ_80M=y
CONFIG_ESPTOOLPY_FLASHMODE_DIO=y
CONFIG_ESPTOOLPY_BAUD_921600=y

# No PSRAM on standard HUZZAH32
CONFIG_ESP32_SPIRAM_SUPPORT=n
```

## boards/waveshare-esp32-s3-lcd-147/sdkconfig.defaults
```kconfig
# Board: Waveshare ESP32-S3-LCD-1.47
# Chip:  ESP32-S3 QFN56 rev0.2
# Flash: 16MB Winbond W25Q128 (Quad SPI)
# PSRAM: 8MB Octal PSRAM
# USB:   Native USB (GPIO19/GPIO20)
#
# This file overrides root sdkconfig.defaults and boards/esp32-s3/sdkconfig.defaults
# for board-specific hardware. Do not change root or esp32-s3 defaults for this board.

CONFIG_BOARD_DUAL_CORE=y
CONFIG_BOARD_HAS_BT_CLASSIC=n
CONFIG_BOARD_HAS_BLE=y
CONFIG_BOARD_HAS_WIFI=y
CONFIG_BOARD_HAS_NATIVE_USB=y
CONFIG_BOARD_HAS_ZIGBEE=n

# Partition table — board-specific single-factory layout (no OTA/SPIFFS at this stage)
CONFIG_PARTITION_TABLE_CUSTOM_FILENAME="boards/waveshare-esp32-s3-lcd-147/partitions.csv"

# Flash — 16MB, overrides root 4MB default (required before OTA expansion or SPIFFS > 4MB)
CONFIG_ESPTOOLPY_FLASHSIZE_16MB=y
CONFIG_ESPTOOLPY_FLASHSIZE="16MB"
CONFIG_ESPTOOLPY_FLASHFREQ_80M=y
CONFIG_ESPTOOLPY_FLASHMODE_DIO=y

# PSRAM — 8MB Octal (CONFIG_SPIRAM_MODE_OCT selects OPI PSRAM on S3)
CONFIG_SPIRAM=y
CONFIG_SPIRAM_MODE_OCT=y

# Native USB — USB Serial/JTAG for early-boot console (before TinyUSB installs)
# After tinyusb_driver_install() the PHY switches to USB OTG; JTAG stops.
CONFIG_ESP_CONSOLE_USB_SERIAL_JTAG=y

# TinyUSB — CDC + MSC composite (SD card as USB mass storage)
# espressif/esp_tinyusb ^1.4.2 required (see idf_component.yml)
CONFIG_TINYUSB_CDC_ENABLED=y
CONFIG_TINYUSB_MSC_ENABLED=y

# FatFS — enable long filename support on heap
# Required: weldml_result.json exceeds 8.3 FAT limit; CSV files written by
# Linux/Windows also use LFN. Without this, fopen() on any non-8.3 path fails.
CONFIG_FATFS_LFN_HEAP=y
CONFIG_FATFS_MAX_LFN=64
```

## main/Kconfig.projbuild
```kconfig
menu "ESP32 Base Template Config"

    config WIFI_SSID
        string "WiFi SSID"
        default ""
        help
            Default WiFi SSID. Can be overridden at runtime via web UI / NVS.

    config WIFI_PASSWORD
        string "WiFi Password"
        default ""
        help
            Default WiFi password. Can be overridden at runtime via web UI / NVS.

    config MQTT_BROKER_URL
        string "MQTT Broker URL"
        default "mqtt://broker.example.com"
        help
            Default MQTT broker URL. Can be overridden at runtime via web UI / NVS.

    config MQTT_BROKER_PORT
        int "MQTT Broker Port"
        default 1883
        help
            Default MQTT broker port.

    config OTA_FIRMWARE_URL
        string "OTA Firmware URL"
        default "https://example.com/firmware.bin"
        help
            HTTPS URL for OTA firmware updates.

    config WEBSERVER_PORT
        int "Web Server Port"
        default 80
        help
            TCP port for the built-in web server.

    config WIFI_AP_SSID
        string "Setup AP SSID"
        default "ESP32-Setup"
        help
            SSID of the SoftAP broadcast when no WiFi credentials are configured.
            Connect your phone to this network to reach the setup UI at 192.168.4.1.

    config WIFI_AP_PASSWORD
        string "Setup AP Password"
        default ""
        help
            Password for the setup AP. Leave empty for an open network (easier
            for first-run setup). Set a password if the deployment environment
            requires it.

    config WIFI_AP_CHANNEL
        int "Setup AP Channel"
        default 1
        range 1 13
        help
            WiFi channel for the setup AP.

    config WIFI_AP_MAX_CONN
        int "Setup AP Max Connections"
        default 4
        range 1 10
        help
            Maximum simultaneous clients on the setup AP.

endmenu
```

## sdkconfig.defaults
```kconfig
# Base sdkconfig defaults — applied to all boards.
# Board-specific files in boards/<chip>/sdkconfig.defaults override these.

# Flash size — must be set before partition table is evaluated
CONFIG_ESPTOOLPY_FLASHSIZE_4MB=y
CONFIG_ESPTOOLPY_FLASHSIZE="4MB"

# Partition table — OTA-capable (two app partitions)
CONFIG_PARTITION_TABLE_CUSTOM=y
CONFIG_PARTITION_TABLE_CUSTOM_FILENAME="partitions.csv"

# NVS
CONFIG_NVS_ASSERT_ERROR_CHECK=n

# HTTP server
CONFIG_HTTPD_MAX_REQ_HDR_LEN=1024
CONFIG_HTTPD_MAX_URI_LEN=512

# OTA — allow plain HTTP firmware URLs for local/dev testing only.
# DISABLE in production: set CONFIG_ESP_HTTPS_OTA_ALLOW_HTTP=n and add a CA
# cert bundle (see esp_crt_bundle or CONFIG_MBEDTLS_CERTIFICATE_BUNDLE).
CONFIG_ESP_HTTPS_OTA_ALLOW_HTTP=y

# MQTT
CONFIG_MQTT_PROTOCOL_311=y
CONFIG_MQTT_TRANSPORT_SSL=y
CONFIG_MQTT_TRANSPORT_WEBSOCKET=y

# Logging
CONFIG_LOG_DEFAULT_LEVEL_INFO=y

# FreeRTOS tick rate
CONFIG_FREERTOS_HZ=1000
```
